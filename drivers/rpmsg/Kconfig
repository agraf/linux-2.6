## drivers/rpmsg/Kconfig
```kconfig
menu "Rpmsg drivers"

# RPMSG always gets selected by whoever wants it
config RPMSG
	tristate
	select VIRTIO
	select VIRTUALIZATION

config RPMSG_PRU
	tristate "PRU RPMsg Communication driver"
	default n
	depends on RPMSG
	depends on REMOTEPROC
	depends on PRUSS_REMOTEPROC
	---help---
	  An rpmsg driver that exposes interfaces to user space, to allow
	  applications to communicate with the PRU processors on available
	  TI SoCs. This is restricted to SoCs that have the PRUSS remoteproc
	  support.

	  If unsure, say N.

config RPMSG_SDEMU
	tristate "PRU SDemu host driver"
	default n
	depends on RPMSG
	depends on REMOTEPROC
	depends on PRUSS_REMOTEPROC
	select CRC7
	---help---
	  An rpmsg driver that implements the ARM side of the SDemu SD card
	  emulation platform. It requires respective firmware and hardware
	  setup on a TI Sitara platform.

	  If unsure, say N.

endmenu
```
